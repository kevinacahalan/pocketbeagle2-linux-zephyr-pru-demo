## manifest/west.yml
```yaml
manifest:
  remotes:
    - name: zephyrproject-rtos
      url-base: https://github.com/zephyrproject-rtos

  projects:
    - name: zephyr
      remote: zephyrproject-rtos
      revision: 3dfb3d0640d1593784b7f58902406f373c3ad2b6
      import: true
```

## yocto/layers/meta-pb2/conf/layer.conf
```bitbake
BBPATH .= ":${LAYERDIR}"

BBFILES += "${LAYERDIR}/recipes-*/*/*.bb ${LAYERDIR}/recipes-*/*/*.bbappend"

BBFILE_COLLECTIONS += "meta-pb2"
BBFILE_PATTERN_meta-pb2 = "^${LAYERDIR}/"
BBFILE_PRIORITY_meta-pb2 = "10"

LAYERDEPENDS_meta-pb2 = "core"
LAYERSERIES_COMPAT_meta-pb2 = "wrynose"
LAYERVERSION_meta-pb2 = "1"
```

## zephyr-m4/west.yml
```yaml
manifest:
  remotes:
    - name: zephyrproject-rtos
      url-base: https://github.com/zephyrproject-rtos

  projects:
    - name: zephyr
      remote: zephyrproject-rtos
      revision: e35b686be50a224e381fd35174be9fcb1a4ddd37  # this hash is Zephyr main on 11 Oct 2026
      import: true
```
