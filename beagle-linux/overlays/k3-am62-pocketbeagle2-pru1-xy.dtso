// SPDX-License-Identifier: MIT
// PocketBeagle 2 PRU1 X/Y transmit pin.
//
// PRU1 bit-bangs UART 8N1 on R30 bit 5. Mux mode 2 is PR0_PRU1_GPO5.
// This pin is not a Linux SPI0 or Zephyr SPI2 ball.
//
//   signal  header  ball  pad offset
//   TX      P1.20   Y24   0x00cc

/dts-v1/;
/plugin/;

#include "ti/k3-pinctrl.h"

&main_pmx0 {
	pb2_pru1_xy_pins: pb2-pru1-xy-pins {
		pinctrl-single,pins = <
			AM62X_IOPAD(0x00cc, PIN_OUTPUT|PIN_DRIVE_STRENGTH_NOMINAL, 2) /* (Y24) VOUT0_DATA5.PR0_PRU1_GPO5 */
		>;
	};
};

&pruss {
	pinctrl-names = "default";
	pinctrl-0 = <&pb2_pru1_xy_pins>;
};
